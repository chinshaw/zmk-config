## boards/shields/cosmos_dactyl/Kconfig.defconfig
```kconfig
if SHIELD_COSMOS_DACTYL_LEFT

config ZMK_KEYBOARD_NAME
    default "cosmos_dactyl"

config ZMK_SPLIT_ROLE_CENTRAL
    default n

endif # SHIELD_COSMOS_DACTYL_LEFT

if SHIELD_COSMOS_DACTYL_LEFT || SHIELD_COSMOS_DACTYL_RIGHT

config ZMK_SPLIT
    default y

config SPI
    default y

config ZMK_RGB_UNDERGLOW
    default y
    select WS2812_STRIP
    select SPI

config ZMK_RGB_UNDERGLOW_BRT_START
    default 50

config ZMK_RGB_UNDERGLOW_EFF_START
    default 3
endif # SHIELD_COSMOS_DACTYL_LEFT || SHIELD_COSMOS_DACTYL_RIGHT
```

## boards/shields/cosmos_dactyl/Kconfig.shield
```kconfig
config SHIELD_COSMOS_DACTYL_LEFT
    bool "PeaMK Left"
    default y if $(shields_list_contains,cosmos_dactyl_r2c_left)
    default y if $(shields_list_contains,cosmos_dactyl_c2r_left)

config SHIELD_COSMOS_DACTYL_RIGHT
    bool "PeaMK Right"
    default y if $(shields_list_contains,cosmos_dactyl_r2c_right)
    default y if $(shields_list_contains,cosmos_dactyl_c2r_right)
```

## orig/boards/shields/cosmos_dactyl/Kconfig.shield
```kconfig
config SHIELD_COSMOS_DACTYL_LEFT
    bool "CosmoDactyl Left"
    default y if $(shields_list_contains,cosmos_dactyl_r2c_left)
    default y if $(shields_list_contains,cosmos_dactyl_c2r_left)

config SHIELD_COSMOS_DACTYL_RIGHT
    bool "CosmoDactyl Right"
    default y if $(shields_list_contains,cosmos_dactyl_r2c_right)
    default y if $(shields_list_contains,cosmos_dactyl_c2r_right)
```
