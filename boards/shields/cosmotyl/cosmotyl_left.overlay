#include "cosmotyl.dtsi"

/ {
    bootloader_key: bootloader_key {
        compatible = "zmk,boot-magic-key";
        key-position = <42>;
        jump-to-bootloader;
    };
};

&left_encoder {
    status = "okay";
};
