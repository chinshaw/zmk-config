// This file was generated from a template. Edit it to match your keyboard.
// See https://zmk.dev/docs/development/hardware-integration/new-shield for more
// instructions.

#include "cosmos_dactyl_c2r.dtsi"

&bootloader_key_left {
    status = "okay";
};

/ {

};
